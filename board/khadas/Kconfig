## board/khadas/kvim3/Kconfig
```kconfig
if TARGET_KHADAS_VIM3

config SYS_SOC
	default "g12b"

config SYS_BOARD
	default "kvim3"

config SYS_VENDOR
	default "khadas"

config SYS_CONFIG_NAME
	default "kvim3"

config CONFIG_AML_ANTIROLLBACK
	bool
	default n

config DTB_BIND_KERNEL
	bool "load dtb from boot part but not flash rsv"
	default n

endif
```

## board/khadas/kvim3l/Kconfig
```kconfig
if TARGET_KHADAS_VIM3L

config SYS_SOC
	default "g12a"

config SYS_BOARD
	default "kvim3l"

config SYS_VENDOR
	default "khadas"

config SYS_CONFIG_NAME
	default "kvim3l"

config CONFIG_AML_ANTIROLLBACK
	bool
	default n

config DTB_BIND_KERNEL
	bool "load dtb from boot part but not flash rsv"
	default n

config AML_REBOOT
	bool "reboot cmd"
	default y
	help
	  Build the Amlogic reboot command set: reboot, systemoff and
	  get_rebootmode. The boot environment needs get_rebootmode to
	  populate ${reboot_mode}; without it every "if test ${reboot_mode}
	  = ..." in the environment is a syntax error that hush treats as
	  true, and the board boots into recovery instead of system.

endif
```
